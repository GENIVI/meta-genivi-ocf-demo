## conf/layer.conf
```bitbake
# We have a conf and classes directory, append to BBPATH
BBPATH .= ":${LAYERDIR}"

# We have a recipes directory, add to BBFILES
BBFILES += "${LAYERDIR}/recipes-*/*/*.bb ${LAYERDIR}/recipes-*/*/*.bbappend"

BBFILE_COLLECTIONS += "genivi-ocf-demo"
BBFILE_PATTERN_genivi-ocf-demo := "^${LAYERDIR}/"

# Define the priority for recipes (.bb files) from this layer,
# choosing carefully how this layer interacts with all of the
# other layers.

BBFILE_PRIORITY_genivi-ocf-demo = "7"

LICENSE_PATH += "${LAYERDIR}/licenses"

LAYERDEPENDS_genivi-ocf-demo = "oic"
```
